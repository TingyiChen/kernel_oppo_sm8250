## drivers/input/oppo_fp_drivers/Kconfig
```kconfig
menuconfig OPPO_FINGERPRINT
	bool "OPPO fingerprint"
	depends on SPI_MASTER
	help
	  Say Y here to enable OPPO fingerprint support

if OPPO_FINGERPRINT
### platform config
config OPPO_FINGERPRINT_QCOM
       default n
       tristate "Fingerprint base on QCOM"

### fingerprint sensor config
config OPPO_FINGERPRINT_GOODIX_OPTICAL
       default n
       tristate "Fingerprint base on goodix optical chip"

endif #OPPO_FINGERPRINT
```

## drivers/power/Kconfig
```kconfig
source "drivers/power/avs/Kconfig"
source "drivers/power/reset/Kconfig"
source "drivers/power/supply/Kconfig"
source "drivers/power/oppo/Kconfig"

config OPPO_SM8250_CHARGER
	tristate "OPPO SM8150 charger driver"
	depends on MFD_SPMI_PMIC
	help
	  Enables support for the oppo charging framework

config OPPO_SHORT_C_BATT_CHECK
	bool "OPPO_SHORT_C_BATT CHECK SUPPORT"
	default n
	depends on MFD_SPMI_PMIC
	help
	  Say Y to include support

config OPPO_CALL_MODE_SUPPORT
	bool "OPPO call mode support"
	help
	  Say Y to include support

config OPPO_SMART_CHARGER_SUPPORT
	bool "OPPO smart charger support"
	help
	  Say Y to include support

config OPPO_SHORT_HW_CHECK
	bool "OPPO_SHORT_HW CHECK SUPPORT"
	default n
	depends on MFD_SPMI_PMIC
	help
	  Say Y to include support

config OPPO_CHIP_SOC_NODE
	bool "OPPO chip soc node"
	help
	  Say Y to include support

config OPPO_SHORT_IC_CHECK
	bool "OPPO_SHORT_IC CHECK SUPPORT"
	default n
	depends on MFD_SPMI_PMIC
	help
	  Say Y to include support

config OPPO_SHORT_USERSPACE
	bool "OPPO batt userspace"
	help
	 Say Y to include support

config OPPO_RTC_DET_SUPPORT
	tristate "OPPO RTC DET SUPPORT"
	default n
	depends on MFD_SPMI_PMIC
	help
	  Say Y to include support

config OPPO_CHECK_CHARGERID_VOLT
	tristate "OPPO CHECK CHARGERID VOLT"
	default n
	depends on MFD_SPMI_PMIC
	help
	  Say Y to include support

config OPPO_SHIP_MODE_SUPPORT
	tristate "OPPO_SHIP_MODE_SUPPORT"
	default n
	depends on MFD_SPMI_PMIC
	help
	  Say Y to include support
```

## drivers/power/oplus/Kconfig
```kconfig
menuconfig OPPO_CHARGER
	bool "OPPO charging system"
	depends on I2C
	select REGMAP_I2C
	help
	  Say Y here to enable OPPO charging system support

if OPPO_CHARGER
#ifdef VENDOR_EDIT /* Jianchao.Shi@BSP.CHG.Basic, 2018/01/12, sjc Add for charging */
config OPLUS_SM8250_CHARGER
	tristate "OPLUS SM8150 charger driver"
	depends on MFD_SPMI_PMIC
	help
	  Enables support for the oplus charging framework

config OPPO_CALL_MODE_SUPPORT
	bool "OPPO call mode support"
	help
	  Say Y to include support

config OPPO_SMART_CHARGER_SUPPORT
	bool "OPPO smart charger support"
	help
	  Say Y to include support

config OPPO_CHIP_SOC_NODE
	bool "OPPO chip soc node"
	help
	  Say Y to include support

config OPPO_SHORT_USERSPACE
	bool "OPPO batt userspace"
	help
	 Say Y to include support

config OPPO_RTC_DET_SUPPORT
	tristate "OPPO RTC DET SUPPORT"
	default n
	depends on MFD_SPMI_PMIC
	help
	  Say Y to include support

config OPPO_CHECK_CHARGERID_VOLT
	tristate "OPPO CHECK CHARGERID VOLT"
	default n
	depends on MFD_SPMI_PMIC
	help
	  Say Y to include support

config OPPO_SHIP_MODE_SUPPORT
	tristate "OPPO_SHIP_MODE_SUPPORT"
	default n
	depends on MFD_SPMI_PMIC
	help
	  Say Y to include support
	  
config OPPO_SHORT_C_BATT_CHECK
	bool "OPPO batt short "
	help
	  Say Y here to declare OPPO batt short	  

config OPPO_STANDARD_BATTERY_CHECK_ADC
	bool "OPPO Official Standard Battery check by ADC"
	help
	  Say Y here to support Official Standard Battery check by ADC

config OPPO_SHORT_IC_CHECK
	bool "OPPO short ic"
	help
	  Say Y here to declare OPPO batt short

config OPPO_SHORT_HW_CHECK
	bool "OPPO batt HW SHORT "
	help
	  Say Y here to declare charging system is on MTK

config OPPO_SHORT_USERSPACE
	bool "OPPO batt userspace"
	help
	  Say Y to include support

config OPPO_CHIP_SOC_NODE
	bool "OPPO chip soc node"
	help
	  Say Y to include support
endif #OPPO_CHARGER
```

## drivers/soc/oplus/Kconfig
```kconfig
#ifdef OPLUS_FEATURE_TP_BASIC
#Renbing.Yao@BSP.TP.Init, 2020/06/18, Add for move device info
config OPPO_COMMON_SOFT
  bool "config oppo common software"
  select OPPO_ARCH_FILE
  help
        define this config to get project verion from sharemem.
        Maybe this value is from CDT or dynamic identify by hardware
        id.

config OPPO_DEVICE_INFO
  bool "config oppo devinfo"
  select OPPO_ARCH_FILE
  help
        define this config to compile devinfo.c for device register
#endif /* OPLUS_FEATURE_TP_BASIC */

#ifdef CONFIG_OPLUS_SYSTEM_KERNEL
#Wen.Luo@Bsp.Kernel.Stability,2020/4/20,OPLUS_SYSTEM_KERNEL_QCOM/OPLUS_SYSTEM_KERNEL_MTK add for qcom/mtk platform
config OPLUS_SYSTEM_KERNEL_QCOM
  bool "config oplus system feature "
  default y
  help
        define this config to Distinguish between qcom and mtk platform
#endif /*CONFIG_OPLUS_SYSTEM_KERNEL*/

#wen.luo@BSP.Kernel.Stability 2020/03/25 add for oplus kernel system
source "drivers/soc/oplus/system/Kconfig"
#endif /* VENDOR_EDIT */
#ifdef OPLUS_FEATURE_SENSOR_SMEM
#qiuzuolin@BSP.Sensor.Basic 2020/07/31 add for oplus sensor smem
source "drivers/soc/oplus/sensor/Kconfig"
#endif /* OPLUS_FEATURE_SENSOR_SMEM */
source "drivers/soc/oplus/device_info/Kconfig"
```

## drivers/soc/oplus/device_info/Kconfig
```kconfig
config OPPO_DEVICE_INFO
  bool "config oppo devinfo software"
  help
    define this config to compile devinfo.c for device register
```

## drivers/soc/oplus/system/Kconfig
```kconfig
config OPLUS_SYSTEM_KERNEL
  bool "config oplus system feature "
  default y
  help
	define this config to add oplus sytstem kernel feature

config OPPO_ARCH_FILE
  bool "for build directory oppo"
  ---help---
  say Y to buid in

config OPPO_COMMON_SOFT
  bool "config oppo common software"
  select OPPO_ARCH_FILE
  help
	define this config to get project verion from sharemem.
	Maybe this value is from CDT or dynamic identify by hardware
	id.

source "drivers/soc/oplus/system/oplus_project/Kconfig"
source "drivers/soc/oplus/system/project_info/Kconfig"
```

## msm-4.19/drivers/input/touchscreen/oppo_touchscreen/Kconfig
```kconfig
config TOUCHIRQ_UPDATE_QOS
	bool "OPPO touchpanel driver update qos"
	help
	  Say Y here if you want to update qos value in irq handler.

config TOUCHPANEL_NEW_SET_IRQ_WAKE
	bool "OPPO platform tp module used"
	help
	  Say Y here if call enable_irq_wake, can not call disable_irq_nosync

config TOUCHPANEL_OPPO
	bool "OPPO tp module"
	help
	  Say Y here if you have touchscreen module.

config TOUCHPANEL_SAMSUNG
#	default y
	bool "TP samsung IC enable or not for OPPO"
	---help---
	say Y to enable driver for Touchpanel using samsung IC

config TOUCHPANEL_ILITEK
#	default y
	bool "TP ilitek IC enable or not for OPPO"
	---help---
	say Y to enable driver for Touchpanel using ilitek IC
	
source "drivers/input/touchscreen/oppo_touchscreen/util_interface/Kconfig"

if TOUCHPANEL_SAMSUNG
source "drivers/input/touchscreen/oppo_touchscreen/Samsung/Kconfig"
endif
```
