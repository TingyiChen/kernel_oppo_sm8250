#include "kona-audio-overlay.dtsi"
#include "kona-camera-sensor-mtp-19066.dtsi"
#include "kona-mtp.dtsi"
#include "kona-pmic-overlay.dtsi"
#include "kona-sde-display.dtsi"
#include "pm8150.dtsi"
#include "pm8150b.dtsi"
#include "pm8150l.dtsi"
