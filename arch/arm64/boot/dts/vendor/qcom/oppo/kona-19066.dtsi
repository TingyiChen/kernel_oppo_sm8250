#include "kona-audio.dtsi"
#include "kona-camera.dtsi"
#include "kona-pcie.dtsi"
#include "kona-pinctrl.dtsi"
#include "kona-regulators.dtsi"
#include "kona-thermal.dtsi"
#include "kona-usb.dtsi"
#include "kona.dtsi"
#include "msm-audio-lpass.dtsi"
