&usb0 {
	qcom,pm-qos-latency = <61>; /* CUP0-WFI-LVL latency +1 */
};

&usb1 {
	status = "disabled";
};

&usb2_phy0 {
	qcom,param-override-seq = <0x66 0x6c
				0x2d 0x70
				0x1c 0x74
				0x00 0x78>;
	qcom,param-override-seq-host = <0x66 0x6c
				0x2d 0x70
				0x1c 0x74
				0x00 0x78>;
};

&usb2_phy1 {
	qcom,param-override-seq = <0x66 0x6c
				0x2d 0x70
				0x1c 0x74
				0x00 0x78>;
	qcom,param-override-seq-host = <0x66 0x6c
				0x2d 0x70
				0x1c 0x74
				0x00 0x78>;
};